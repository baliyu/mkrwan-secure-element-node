/*
 * se_provision.ino - secure element project, step 6: load the LoRa link keys
 * into slot 10, LOCK THE DATA ZONE (PERMANENT), then prove both keys work.
 *
 * Before the lock (refuses to continue otherwise):
 *   - configuration locked and equal to the reviewed image
 *   - data zone still unlocked
 *   - slot 0 still holds the identity key recorded in step 5
 * Then:
 *   1. Write the two link keys (32 bytes) into slot 10, block 0.
 *   2. Type LOCK DATA -> Lock(data zone). No CRC is possible: it would have
 *      to include slot 0's private key, which nobody knows.
 *   3. AES from slot 10 on two known-answer blocks computed on the PC.
 *      MATCH  -> the link keys are inside the chip and usable, never readable.
 *      Refused -> documented fallback: AES with the key in TempKey (step 6a
 *                 proved that path works); the identity key is unaffected.
 *   4. Sign a fresh random challenge with the identity key (slot 0) and print
 *      SIGN_MSG / SIGNATURE for tools/se_verify_sig.py on the PC.
 *
 * se_provision_data.h is SECRET (it contains the link keys): generated by
 * tools/se_provision.py, git-ignored, delete it from the PC after this step.
 * Serial Monitor: 115200 baud, line ending "Newline".
 */
#include <ArduinoECCX08.h>
#include "se_config_image.h"
#include "se_provision_data.h"
#include "atecc_io.h"

const int OFF_LOCK_VALUE = 86;
const int OFF_LOCK_CONFIG = 87;

static void printHex(uint8_t b)
{
  if (b < 0x10) Serial.print('0');
  Serial.print(b, HEX);
}

static void printBytes(const uint8_t *d, int n)
{
  for (int i = 0; i < n; i++) printHex(d[i]);
}

static void stop(const char *why)
{
  Serial.print("STOPPED: ");
  Serial.println(why);
  Serial.println("Nothing more will be done.");
  while (1) { }
}

static void explainStatus(int s)
{
  if (s < 0)          Serial.print("no valid answer from the chip");
  else if (s == 0x0F) Serial.print("status 0x0F (execution error)");
  else if (s == 0x03) Serial.print("status 0x03 (parse error)");
  else if (s == 0x01) Serial.print("status 0x01 (miscompare)");
  else if (s == 0xFF) Serial.print("status 0xFF (CRC error on the bus)");
  else { Serial.print("status 0x"); printHex((uint8_t)s); }
}

static String readLine()
{
  String line;
  while (true) {
    if (Serial.available()) {
      int c = Serial.read();
      if (c < 0) continue;
      if (c == '\n' || c == '\r') {
        if (line.length() > 0) break;
      } else if (c >= 0x20 && c <= 0x7E) {
        line += (char)c;
      }
    }
  }
  line.trim();
  Serial.print("Received: \"");
  Serial.print(line.c_str());
  Serial.println("\"");
  return line;
}

void setup()
{
  Serial.begin(115200);
  while (!Serial) { }
  delay(200);
  Serial.println();
  Serial.println("=== Step 6: load link keys, LOCK DATA ZONE (permanent), test ===");

  if (!ECCX08.begin()) stop("no ATECC608 answering at I2C 0x60");
  uint8_t cfg[128];
  if (!ECCX08.readConfiguration(cfg)) stop("could not read the configuration zone");
  if (cfg[OFF_LOCK_CONFIG] != 0x00) stop("config zone is NOT locked");
  for (int i = 0; i < 128; i++) {
    if (i != OFF_LOCK_CONFIG && i != OFF_LOCK_VALUE && cfg[i] != SE_CONFIG_IMAGE[i]) stop("configuration differs from the reviewed image");
  }
  bool alreadyLocked = (cfg[OFF_LOCK_VALUE] == 0x00);

  uint8_t pub[64];
  if (!ECCX08.generatePublicKey(SE_IDENTITY_SLOT, pub)) stop("slot 0 holds no valid identity key");
  if (memcmp(pub, SE_IDENTITY_PUBKEY, 64) != 0) stop("slot 0 key differs from the one recorded in step 5");
  Serial.println("Config locked and as reviewed; slot 0 holds the step 5 identity key.");

  if (alreadyLocked) {
    Serial.println("Data zone is ALREADY locked - skipping key load and lock, running the tests only.");
  } else {
    Serial.println("Data zone unlocked.");

    // ---- 1. load the link keys ----
    int s = atecc::writeSlotBlock(SE_AES_SLOT, 0, SE_LINK_KEYS);
    Serial.print("Write link keys to slot 10, block 0: ");
    if (s != 0) { explainStatus(s); Serial.println(); stop("could not write the link keys"); }
    Serial.println("OK");

    // ---- 2. lock the data zone ----
    Serial.println();
    Serial.println("About to LOCK the DATA zone. This can never be undone:");
    Serial.println("  - slot 10 (link keys) can then never be read or rewritten");
    Serial.println("  - slot 0 (identity key) stays secret");
    Serial.println("  - if AES from slot 10 is refused afterwards, the fallback is AES via TempKey");
    delay(100);
    while (Serial.available()) Serial.read();
    Serial.println("Type LOCK DATA and press Enter to lock, anything else to cancel:");
    if (!(readLine() == "LOCK DATA")) stop("cancelled by user - data zone NOT locked (keys can still be rewritten)");

    s = atecc::lockDataNoCrc();
    Serial.print("Lock (data zone) status: ");
    if (s == 0) Serial.println("0x00 (success)"); else { explainStatus(s); Serial.println(); }
  }

  uint8_t after[128];
  if (!ECCX08.readConfiguration(after)) stop("could not read the configuration back");
  Serial.print("LockValue (byte 86) now: 0x"); printHex(after[OFF_LOCK_VALUE]);
  Serial.println(after[OFF_LOCK_VALUE] == 0x00 ? "  -> DATA ZONE LOCKED" : "  -> still unlocked");
  if (after[OFF_LOCK_VALUE] != 0x00) stop("data zone did not lock - paste this output");

  // ---- 3. AES from slot 10 ----
  Serial.println();
  Serial.println("Test 1: AES from slot 10 against known answers computed on the PC");
  int passed = 0, refused = 0;
  for (uint8_t kb = 0; kb < 2; kb++) {
    uint8_t out[16];
    int r = atecc::aesEncrypt(SE_AES_SLOT, kb, SE_KAT_PT[kb], out);
    Serial.print(kb == 0 ? "  key block 0 (enc): " : "  key block 1 (MIC): ");
    if (r != 0) { Serial.print("refused - "); explainStatus(r); Serial.println(); refused++; continue; }
    bool ok = memcmp(out, SE_KAT_CT[kb], 16) == 0;
    printBytes(out, 16);
    Serial.println(ok ? "  MATCH" : "  MISMATCH");
    if (ok) passed++;
  }
  if (passed == 2) Serial.println("Test 1 PASSED: the link keys are in slot 10 and work; they can never be read out.");
  else if (refused) Serial.println("Test 1: slot AES refused even after the data lock -> use the TempKey fallback (documented).");
  else Serial.println("Test 1 FAILED: wrong result - paste this output.");

  // ---- 4. signature with the identity key ----
  Serial.println();
  Serial.println("Test 2: ECDSA signature with the identity key (slot 0)");
  uint8_t msg[32], sig[64];
  if (!ECCX08.random(msg, sizeof(msg))) stop("RNG failed");
  if (!ECCX08.ecSign(SE_IDENTITY_SLOT, msg, sig)) {
    Serial.println("  Sign refused.");
  } else {
    Serial.print("SIGN_MSG: ");  printBytes(msg, 32); Serial.println();
    Serial.print("SIGNATURE: "); printBytes(sig, 64); Serial.println();
    Serial.println("  Verify on the PC: python3 tools/se_verify_sig.py docs/step6_provision_output.txt docs/device_identity_pub.pem");
  }
  Serial.println();
  Serial.println("Step 6 complete. Now delete firmware/se_provision/se_provision_data.h from the PC.");
}

void loop()
{
}
