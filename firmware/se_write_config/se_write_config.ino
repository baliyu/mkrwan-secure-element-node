/*
 * se_write_config.ino - secure element project, step 3: write the reviewed
 * configuration to the ATECC608, read it back and compare. Does NOT lock.
 *
 * The configuration zone stays rewritable until it is locked (step 4), so
 * this step is reversible: running it again, or with an edited image,
 * simply overwrites the previous values.
 *
 * Board: Arduino MKR WAN 1310. Library: ArduinoECCX08.
 * se_config_image.h is generated by tools/se_config.py from this chip's own
 * step 1 dump, so it refuses to run on a different chip.
 *
 * Serial Monitor: 115200 baud, line ending "Newline".
 */
#include <ArduinoECCX08.h>
#include "se_config_image.h"

const int OFF_LOCK_VALUE = 86;
const int OFF_LOCK_CONFIG = 87;

// ATECC CRC-16 (poly 0x8005, LSB first), same as CryptoAuthLib atCRC.
static uint16_t crc16(const uint8_t *data, size_t len)
{
  uint16_t crc = 0;
  for (size_t i = 0; i < len; i++) {
    for (uint8_t bit = 0x01; bit != 0; bit <<= 1) {
      uint8_t data_bit = (data[i] & bit) ? 1 : 0;
      uint8_t crc_bit = (uint8_t)(crc >> 15);
      crc <<= 1;
      if (data_bit != crc_bit) crc ^= 0x8005;
    }
  }
  return crc;   // stored little-endian, as SE_CONFIG_LOCK_CRC
}

static void printHex(uint8_t b)
{
  if (b < 0x10) Serial.print('0');
  Serial.print(b, HEX);
}

static void stop(const char *why)
{
  Serial.print("STOPPED: ");
  Serial.println(why);
  Serial.println("Nothing more will be done.");
  while (1) { }
}

// Lists differences between the chip and the image; returns how many.
static int listDiffs(const uint8_t *chip)
{
  int n = 0;
  for (int i = 0; i < 128; i++) {
    if (chip[i] != SE_CONFIG_IMAGE[i]) {
      Serial.print("  byte ");
      Serial.print(i);
      Serial.print(": chip 0x");
      printHex(chip[i]);
      Serial.print("  image 0x");
      printHex(SE_CONFIG_IMAGE[i]);
      Serial.println();
      n++;
    }
  }
  return n;
}

// Reads one line from the Serial Monitor. Keeps printable characters only,
// echoes what arrived (as text and hex) so a mismatch can be diagnosed.
static bool waitForWord(const char *word)
{
  String line;
  String hex;
  while (true) {
    if (Serial.available()) {
      int c = Serial.read();
      if (c < 0) continue;
      if (hex.length() < 60) {           // keep the echo short
        if (c < 0x10) hex += '0';
        hex += String(c, HEX);
        hex += ' ';
      }
      if (c == '\n' || c == '\r') {
        if (line.length() > 0) break;    // end of a non-empty line
      } else if (c >= 0x20 && c <= 0x7E) {
        line += (char)c;
      }
    }
  }
  line.trim();
  Serial.print("Received: \"");
  Serial.print(line.c_str());
  Serial.print("\"  (bytes: ");
  Serial.print(hex.c_str());
  Serial.println(")");
  return line == word;
}

void setup()
{
  Serial.begin(115200);
  while (!Serial) { }
  delay(200);
  Serial.println();
  Serial.println("=== Step 3: write configuration (no lock) ===");

  // Sanity check on the image itself before touching the chip
  if (crc16(SE_CONFIG_IMAGE, 128) != SE_CONFIG_LOCK_CRC) stop("image and its CRC disagree - regenerate the header");

  if (!ECCX08.begin()) stop("no ATECC608 answering at I2C 0x60");

  uint8_t chip[128];
  if (!ECCX08.readConfiguration(chip)) stop("could not read the configuration zone");

  if (chip[OFF_LOCK_CONFIG] != 0x55) stop("config zone is LOCKED - it can no longer be written");
  if (chip[OFF_LOCK_VALUE] != 0x55)  stop("data zone is locked - unexpected at this step");

  // Bytes 0-15 (serial number, revision, ...) are factory values: they
  // prove this image was made for THIS chip.
  for (int i = 0; i < 16; i++) {
    if (chip[i] != SE_CONFIG_IMAGE[i]) stop("this image was generated for a different chip (bytes 0-15 differ)");
  }
  Serial.println("Image matches this chip's serial number and revision.");

  Serial.println("Differences between chip and image:");
  int n = listDiffs(chip);
  if (n == 0) {
    Serial.println("  none - the chip already holds the image. Nothing written.");
  } else {
    Serial.print(n);
    Serial.println(" byte(s) will change. The config zone is NOT locked by this sketch.");
    delay(100);
    while (Serial.available()) Serial.read();   // drop anything sent before the prompt
    Serial.println("Type WRITE and press Enter to write, anything else to cancel:");
    if (!waitForWord("WRITE")) stop("cancelled by user");

    if (!ECCX08.writeConfiguration(SE_CONFIG_IMAGE)) stop("writeConfiguration() failed");
    Serial.println("Written.");
  }

  // Read back and compare every byte
  uint8_t back[128];
  if (!ECCX08.readConfiguration(back)) stop("could not read back the configuration zone");
  Serial.println("Read-back differences:");
  if (listDiffs(back) != 0) stop("read-back does NOT match the image");
  Serial.println("  none - all 128 bytes match the image.");

  uint16_t crc = crc16(back, 128);
  Serial.print("CRC of the chip's configuration: 0x");
  printHex(crc >> 8); printHex(crc & 0xFF);
  Serial.print("  expected for the lock: 0x");
  printHex(SE_CONFIG_LOCK_CRC >> 8); printHex(SE_CONFIG_LOCK_CRC & 0xFF);
  Serial.println(crc == SE_CONFIG_LOCK_CRC ? "  MATCH" : "  MISMATCH");

  Serial.print("Config zone lock byte: 0x");
  printHex(back[OFF_LOCK_CONFIG]);
  Serial.println(back[OFF_LOCK_CONFIG] == 0x55 ? " (still UNLOCKED, as intended)" : " (UNEXPECTED)");
  Serial.println("Step 3 complete.");
}

void loop()
{
}
